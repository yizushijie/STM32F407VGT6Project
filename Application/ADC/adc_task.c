#include "adc_task.h"

///////////////////////////////////////////////////////////////////////////////
//////函		数：
//////功		能：
//////输入参数:
//////输出参数:
//////说		明：
//////////////////////////////////////////////////////////////////////////////
UINT8_T ADCTask_ADC_Init(void)
{
	return ADCLib_ADC_Init();
}

///////////////////////////////////////////////////////////////////////////////
//////函		数：
//////功		能：
//////输入参数:
//////输出参数:
//////说		明：
//////////////////////////////////////////////////////////////////////////////
UINT8_T ADCTask_ADCTask_START(ADC_TypeDef *ADCx)
{
	return  ADCLib_ADCTask_START(ADCx);
}

///////////////////////////////////////////////////////////////////////////////
//////函		数：
//////功		能：
//////输入参数:
//////输出参数:
//////说		明：
//////////////////////////////////////////////////////////////////////////////
UINT8_T ADCTask_ADCTask_STOP(ADC_TypeDef *ADCx)
{
	return ADCLib_ADCTask_STOP(ADCx);
}

///////////////////////////////////////////////////////////////////////////////
//////函		数：
//////功		能：
//////输入参数:
//////输出参数:
//////说		明：
//////////////////////////////////////////////////////////////////////////////
UINT8_T ADCTask_HandleChannelVal(ADCASK_HandlerType *ADCASKx)
{
	return ADCLib_HandleChannelVal(ADCASKx);
}

///////////////////////////////////////////////////////////////////////////////
//////函		数：
//////功		能：
//////输入参数:
//////输出参数:
//////说		明：
//////////////////////////////////////////////////////////////////////////////
UINT8_T ADCTask_RFASKTask_GetADC(UINT16_T *pVal, UINT8_T num)
{
	UINT8_T _return = OK_0;

	//---启动ADC
	ADCLib_ADCTask_START(ADC1);
	if (num > 2)
	{
		ADCLib_ADCTask_START(ADC3);
	}

	//---等待ADC转换完成
	while (pABChannelADC->msgFlag == 0);
	if (num > 2)
	{
		while (pCDChannelADC->msgFlag == 0);
	}

	//---处理采集的数据
	ADCLib_HandleChannelVal(pABChannelADC);
	if (num > 2)
	{
		ADCLib_HandleChannelVal(pCDChannelADC);
	}

	//---获取采集的数据
	for (_return = 0; _return < num; _return++)
	{
		switch (_return)
		{
			case 0:
				pVal[0] = pABChannelADC->msgAChannelVal;
				break;
			case 1:
				pVal[1] = pABChannelADC->msgBChannelVal;
				break;
			case 2:
				pVal[2] = pCDChannelADC->msgAChannelVal;
				break;
			case 3:
				pVal[3] = pCDChannelADC->msgBChannelVal;
				break;
			default:
				memset(pVal, 0, num);
				break;
		}
	}
	return OK_0;
}

///////////////////////////////////////////////////////////////////////////////
//////函		数：
//////功		能：
//////输入参数:
//////输出参数:
//////说		明：
//////////////////////////////////////////////////////////////////////////////
UINT16_T ADCTask_GetChipPower(void)
{
	return ADCLib_GetChipPower();
}